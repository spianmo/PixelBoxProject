## firmware-nuttx/Kconfig
```kconfig
config INTERPRETERS_PIXELBOX
	tristate "PixelBox QuickJS runtime"
	default n
	select DEV_URANDOM
	help
		PixelBox JavaScript FFI over NuttX POSIX APIs. QuickJS-ng v0.10.1;
		no ESP-IDF, FreeRTOS or C++ runtime dependency.

if INTERPRETERS_PIXELBOX

config INTERPRETERS_PIXELBOX_PROGNAME
	string "Program name"
	default "pixelbox"

config INTERPRETERS_PIXELBOX_PRIORITY
	int "Task priority"
	default 100

config INTERPRETERS_PIXELBOX_STACKSIZE
	int "Task stack size"
	default 65536

config INTERPRETERS_PIXELBOX_HEAP_SIZE
	int "JavaScript heap limit"
	default 4194304

config INTERPRETERS_PIXELBOX_APP_ROOT
	string "Application package root (virtual /app)"
	default "/data/app"

config INTERPRETERS_PIXELBOX_DATA_ROOT
	string "Writable storage root (virtual /data)"
	default "/data"

config INTERPRETERS_PIXELBOX_CONSOLE_AFTER_APP
	bool "Open NSH console after the boot application exits"
	default y
	depends on NSH_CONSOLE
	help
		Allows explicit filesystem provisioning and recovery over the serial
		console. The console starts once per boot, never recursively from an
		NSH pixelbox command. Disable NSH_ARCHINIT when BOARD_LATE_INITIALIZE
		already initializes the board devices.

config INTERPRETERS_PIXELBOX_PORTAL
	bool "Enable the Wi-Fi provisioning portal"
	default n
	depends on ESPRESSIF_WIFI_STATION_SOFTAP && NETDEV_WIRELESS_IOCTL
	depends on NETUTILS_DHCPD && NET_BINDTODEVICE
	help
		Build the service-owned APSTA provisioning portal. Boot only prepares
		lightweight state; a software or button request is required to open
		the AP. Requires the runner's APSTA and DHCPD patches. Allocates
		40 KiB of worker stacks only after the application VM has exited,
		then joins both workers before restoring the application VM.

config INTERPRETERS_PIXELBOX_TIMED_SLEEP
	bool "Enable explicit bounded timer deep sleep"
	default n
	depends on ARCH_CHIP_ESP32S3 && PM
	help
		Accept 1..86400000 ms from a managed VM; wait for cleanup before
		entering RTC timer deep sleep. Requires PM_GOVERNOR_EXPLICIT_RELAX=-1
		to prevent automatic idle sleep. Radio builds currently reject sleep
		until their complete shutdown can be verified. Wake restarts the OS
		and leaves the application stopped until an explicit restart.

config INTERPRETERS_PIXELBOX_MULTINET7
	bool "Enable MultiNet7 local wakeword"
	default n
	depends on ARCH_CHIP_ESP32S3 && ESP32S3_SPIRAM
	depends on XTENSA_IMEM_USE_SEPARATE_HEAP && ARCH_SETJMP_H
	help
		Build the audited ESP-SR 2.5.3 MultiNet7 Chinese model and worker.
		Use the esp32s3-multinet7 runner profile to prepare the model and
		require XTENSA_CP_INITSET=0x0009. A recognition session reserves
		4 MiB contiguous PSRAM and a 32 KiB internal worker stack.
		The generated image must fit before the fixed 8 MiB data boundary.

config INTERPRETERS_PIXELBOX_FRAMEBUFFER
	bool "Use a NuttX framebuffer device"
	default n
	depends on VIDEO_FB
	help
		Requires a board-provided framebuffer at the path below. Supports
		RGB565, RGB24 and RGB32. Does not install a display controller driver.

config INTERPRETERS_PIXELBOX_FB_DEVICE
	string "Framebuffer path"
	default "/dev/fb0"
	depends on INTERPRETERS_PIXELBOX_FRAMEBUFFER

endif
```

## firmware-nuttx/boards/xtensa/esp32s3/esp32s3-devkit/Kconfig
```kconfig
#
# PixelBox overlay for the ESP32-S3 DevKit board Kconfig.
#

if ARCH_BOARD_ESP32S3_DEVKIT

# CO5300 is a board-level QSPI framebuffer, so request the generic
# framebuffer update ioctl even though the SoC LCD peripheral is unused.
config ESP32S3_DEVKIT_PIXELBOX_FB
	bool
	default y
	select FB_UPDATE

choice
	prompt "ESP32-S3-DevKitC-1 version"
	default ESP32S3_DEVKITC_1_V10

config ESP32S3_DEVKITC_1_V10
	bool "ESP32-S3-DevKitC-1 v1.0"

config ESP32S3_DEVKITC_1_V11
	bool "ESP32-S3-DevKitC-1 v1.1"
endchoice

config ESP32S3_STORAGE_MTD_OFFSET
	hex "Storage MTD base address in SPI Flash"
	default 0x180000 if !ESP32S3_HAVE_OTA_PARTITION
	default 0x250000 if ESP32S3_HAVE_OTA_PARTITION
	depends on ESP32S3_MTD
	---help---
		MTD base address in SPI Flash.

config ESP32S3_STORAGE_MTD_SIZE
	hex "Storage MTD size in SPI Flash"
	default 0x100000
	range 0x0 0x400000 if ESP32S3_FLASH_4M
	range 0x0 0x800000 if ESP32S3_FLASH_8M
	range 0x0 0x1000000 if ESP32S3_FLASH_16M
	range 0x0 0x2000000 if ESP32S3_FLASH_32M
	depends on ESP32S3_MTD
	---help---
		MTD size in SPI Flash.

choice ESP32S3_SPIFLASH_FS
	prompt "Mount SPI Flash MTD on bring-up"
	default ESP32S3_SPIFLASH_SMARTFS
	depends on ESP32S3_MTD
	optional
	---help---
		Mount the SPI Flash MTD with the selected File System format on board.

config ESP32S3_SPIFLASH_SMARTFS
	bool "SmartFS"
	select FS_SMARTFS
	select MTD_SMART

config ESP32S3_SPIFLASH_NXFFS
	bool "NXFFS"
	select FS_NXFFS

config ESP32S3_SPIFLASH_SPIFFS
	bool "SPIFFS"
	select FS_SPIFFS

config ESP32S3_SPIFLASH_LITTLEFS
	bool "LittleFS"
	select FS_LITTLEFS

endchoice # ESP32S3_SPIFLASH_FS

if PM

config PM_ALARM_SEC
	int "PM_STANDBY delay (seconds)"
	default 15

config PM_ALARM_NSEC
	int "PM_STANDBY delay (nanoseconds)"
	default 0

config PM_SLEEP_WAKEUP_SEC
	int "PM_SLEEP delay (seconds)"
	default 20

config PM_SLEEP_WAKEUP_NSEC
	int "PM_SLEEP delay (nanoseconds)"
	default 0

endif # PM

endif # ARCH_BOARD_ESP32S3_DEVKIT
```

## firmware/components/bindings_speech/Kconfig
```kconfig
menu "PixelBox 独立语音 (bindings_speech)"

config PX_ENABLE_SPEECH
    bool "启用 ESP-SR 离线命令唤醒与 Azure 直连语音"
    depends on PX_ENABLE_AUDIO && IDF_TARGET_ESP32S3
    default n
    help
        S3 默认配置启用：MultiNet7 中文模型检测你好小川，
        原生 TLS 请求 Azure STT/TTS，不依赖手机。需要 16MB flash、8MB PSRAM。
        使用 partitions_speech.csv，不能通过旧非语音布局单应用 OTA 安装。

endmenu
```

## firmware/components/devd/Kconfig
```kconfig
menu "PixelBox devd"

    config DEVD_PORT
        int "devd WebSocket 端口"
        default 8765
        help
            协议约定端口 8765 (architecture.md §5), 一般无需修改。

    config DEVD_LOG_RING
        int "日志环形缓冲条数"
        default 128

    config DEVD_HTTPD_STACK
        int "HTTP 服务器任务栈 (字节)"
        default 8192

    config DEVD_MAX_FRAME_KB
        int "单个 WS 帧上限 (KB)"
        default 96
        help
            push_chunk 单块 ≤32KB, base64 后约 44KB, 预留余量。

endmenu
```

## firmware/components/hal_audio/Kconfig
```kconfig
menu "PixelBox 音频 HAL (hal_audio)"

config PX_ENABLE_AUDIO
    bool "启用音频栈 (I2S + ES8311 codec + 解码器)"
    default n if IDF_TARGET_ESP32C6
    default y
    help
        关闭后 hal_audio 不编译, bindings_audio/voicechat 切换为 ENOTSUP
        桩 (px.audio/px.voice API 表面保留, 调用抛 Error("ENOTSUP")),
        esp_codec_dev/esp_audio_codec/esp-sr 均不参与链接。
        无 PSRAM 的小内存目标 (ESP32-C6) 默认关闭以省 flash/RAM;
        S3/P4 默认开启。

config PX_AUDIO_TASK_CORE
    int "音频任务绑定核心"
    range 0 0 if FREERTOS_UNICORE
    range 0 1
    default 0
    help
        采集/播放/解码任务所在核心。JS 线程固定在核 1,音频任务默认放核 0
        (单核目标恒为 0)。

config PX_AUDIO_CAPTURE_PRIO
    int "采集任务优先级"
    range 1 24
    default 15

config PX_AUDIO_PLAYBACK_PRIO
    int "播放(混音)任务优先级"
    range 1 24
    default 15

config PX_AUDIO_DECODE_PRIO
    int "解码任务优先级"
    range 1 24
    default 5

config PX_AUDIO_DECODE_RING_KB
    int "解码输出 PCM 环形缓冲 (KB, PSRAM)"
    range 32 2048
    default 128
    help
        player.play() 解码任务与混音器之间的缓冲。44.1kHz 单声道下 128KB 约 1.5 秒。

config PX_AUDIO_STREAM_RING_KB
    int "openPcmStream 默认环形缓冲 (KB, PSRAM)"
    range 64 4096
    default 512
    help
        TTS 流式播放缓冲。24kHz 单声道下 512KB 约 10.9 秒。

config PX_AUDIO_MIC_QUEUE_FRAMES
    int "JS 麦克风帧队列深度"
    range 2 64
    default 8
    help
        JS 线程未及时消费时最多积压的帧数,超出丢弃最旧帧并告警。

endmenu
```

## firmware/components/hal_display/Kconfig
```kconfig
menu "PixelBox 显示 (hal_display)"

    config PX_DISPLAY_STRIP_LINES
        int "SPI 屏行带 (strip) flush 高度 (行)"
        depends on BOARD_GENERIC_SPI
        range 8 240
        default 40
        help
            通用 SPI 屏后端 (ST7789) 的中转缓冲按「行带」分配:
            宽 = 面板宽, 高 = 本值, DMA 内部内存。240 宽 x 40 行 x 2B
            = 18.75KB。行带越大 flush 次数越少 (稍快), 越小越省内部
            内存 —— 无 PSRAM 的 C6 建议保持默认或调小。

endmenu
```

## firmware/components/hal_net/Kconfig
```kconfig
menu "PixelBox Network"
    config PX_WIFI_POWER_SAVE
        bool "Enable Wi-Fi modem sleep (higher interactive latency)"
        default n
        help
            Disabling modem sleep avoids DTIM delays in TLS handshakes and
            streaming uploads. Enable for battery-first workloads that can
            tolerate increased network latency.
endmenu
```

## firmware/components/hal_periph/Kconfig
```kconfig
menu "PixelBox 外设 (hal_periph)"

    comment "共享 I2C/触摸/IMU/按键引脚由 boards 组件提供 (hal_common/board.h)"
    comment "此处仅保留 hal_periph 自有外设 (BLE/摄像头/GPS/灯带) 的开关与引脚"

    # ------------------------------------------------------------
    # 触摸
    # ------------------------------------------------------------
    config PX_TOUCH_POLL_MS
        int "触摸轮询周期 ms"
        range 5 50
        default 10

    # ------------------------------------------------------------
    # BLE (NimBLE)
    # ------------------------------------------------------------
    config PX_ENABLE_BLE
        bool "启用 BLE (px.ble)"
        default y
        help
            还需要 sdkconfig 打开 CONFIG_BT_ENABLED + CONFIG_BT_NIMBLE_ENABLED,
            否则 px.ble.available() 返回 false。

    # ------------------------------------------------------------
    # 摄像头 OV2640 (DVP, 定制板 CUSTOM_V1 可选)
    # 引脚归属说明: boards 尚未提供 camera 配置 getter, DVP 引脚暂由
    # 本组件 Kconfig 收敛; 待 boards 增加 board_camera_config() 后迁移。
    # ------------------------------------------------------------
    config PX_ENABLE_CAMERA
        bool "启用摄像头 (px.camera)"
        default n
        help
            Stage B 定制板外设。建议与 BOARD_CV1_HAS_CAMERA 同时开启,
            运行期可用性 = 本开关 AND board_caps()->camera。

    if PX_ENABLE_CAMERA
        config PX_CAM_PIN_XCLK
            int "CAM XCLK GPIO"
            default 8
        config PX_CAM_PIN_PCLK
            int "CAM PCLK GPIO"
            default 9
        config PX_CAM_PIN_VSYNC
            int "CAM VSYNC GPIO"
            default 4
        config PX_CAM_PIN_HREF
            int "CAM HREF GPIO"
            default 5
        config PX_CAM_PIN_SIOD
            int "CAM SCCB SDA GPIO"
            default 15
        config PX_CAM_PIN_SIOC
            int "CAM SCCB SCL GPIO"
            default 14
        config PX_CAM_PIN_D0
            int "CAM D0 GPIO"
            default 10
        config PX_CAM_PIN_D1
            int "CAM D1 GPIO"
            default 11
        config PX_CAM_PIN_D2
            int "CAM D2 GPIO"
            default 12
        config PX_CAM_PIN_D3
            int "CAM D3 GPIO"
            default 13
        config PX_CAM_PIN_D4
            int "CAM D4 GPIO"
            default 16
        config PX_CAM_PIN_D5
            int "CAM D5 GPIO"
            default 17
        config PX_CAM_PIN_D6
            int "CAM D6 GPIO"
            default 18
        config PX_CAM_PIN_D7
            int "CAM D7 GPIO"
            default 46
        config PX_CAM_PIN_PWDN
            int "CAM PWDN GPIO (-1 未接)"
            default -1
        config PX_CAM_PIN_RESET
            int "CAM RESET GPIO (-1 未接)"
            default -1
    endif

    # ------------------------------------------------------------
    # GPS (UART NMEA, 定制板 CUSTOM_V1 可选)
    # ------------------------------------------------------------
    config PX_ENABLE_GPS
        bool "启用 GPS (px.gps)"
        default n
        help
            Stage B 定制板外设。建议与 BOARD_CV1_HAS_GPS 同时开启。

    if PX_ENABLE_GPS
        config PX_GPS_UART_NUM
            int "GPS UART 端口号"
            range 0 2
            default 1
        config PX_GPS_RX_GPIO
            int "GPS RX GPIO (接模块 TX)"
            default 44
        config PX_GPS_TX_GPIO
            int "GPS TX GPIO (接模块 RX, -1 不接)"
            default 43
        config PX_GPS_BAUD
            int "GPS 波特率"
            default 9600
    endif

    # ------------------------------------------------------------
    # WS2812 灯带 (RMT, 定制板 CUSTOM_V1 可选)
    # ------------------------------------------------------------
    config PX_ENABLE_LED
        bool "启用灯带 (px.led)"
        default n
        help
            Stage B 定制板外设。建议与 BOARD_CV1_HAS_LED 同时开启。

    if PX_ENABLE_LED
        config PX_LED_GPIO
            int "灯带数据 GPIO"
            default 38
        config PX_LED_COUNT
            int "灯珠数量"
            range 1 1024
            default 8
    endif

endmenu
```

## firmware/components/jsvm/Kconfig
```kconfig
menu "PixelBox JSVM"

    config JSVM_MEM_LIMIT_KB
        int "JS 堆上限 (KB)"
        default 256 if !SPIRAM
        default 4096
        help
            QuickJS 运行时内存上限。分配经自定义分配器
            (hal_common/px_alloc.h) 优先落 PSRAM, 无 PSRAM 目标 (C6 /
            关闭 SPIRAM 时) 自动落内部堆 —— 此时默认收缩到 256KB,
            为帧缓冲/网络栈保留内部内存余量。
            按目标默认: S3 (8MB PSRAM) / P4 (PSRAM) = 4096; C6 = 256。

    config JSVM_TASK_STACK_KB
        int "js_task 栈大小 (KB)"
        default 32
        help
            JS 唯一执行线程的栈。QuickJS 的栈溢出检查阈值会按
            (本值 - 12KB) 自动适配, 保证原生侧仍有安全余量。

    config JSVM_TASK_STACK_IN_PSRAM
        bool "js_task 栈分配在 PSRAM (谨慎开启)"
        default n
        help
            注意: js_task 会直接执行 littlefs 文件读写 (加载应用入口 /
            readAsset / px.storage.fs)。SPI flash 操作期间 cache 被关闭,
            栈在 PSRAM 的任务此时访问栈会触发崩溃, 因此默认栈放内部 RAM。
            仅当确认 JS 线程完全不触碰 flash (或启用了 flash 自动挂起
            特性) 时才可开启本选项以节省内部内存。

    config JSVM_TASK_CORE
        int "js_task 绑定核心"
        range 0 0 if FREERTOS_UNICORE
        range 0 1
        default 0 if FREERTOS_UNICORE
        default 1
        help
            双核目标 (S3/P4) 默认核 1 (核 0 留给 WiFi/音频);
            单核目标 (C6) 恒为核 0。

    config JSVM_TASK_PRIORITY
        int "js_task 优先级"
        default 5

    config JSVM_QUEUE_DEPTH
        int "事件队列深度"
        default 64

endmenu
```

## firmware/components/voicechat/Kconfig
```kconfig
menu "PixelBox 语音对话 (voicechat)"

config PX_ENABLE_WAKEWORD
    bool "启用 esp-sr wakenet 唤醒词"
    default n
    help
        开启后 px.voice.configure({ wakeword: true }) 生效:idle 态待机
        侦听,命中唤醒词自动进入 listening 并投递 "wake" 事件。
        请勿单独打开本开关,应使用 sdkconfig.wakeword 叠加构建
        (一并切换 partitions_wakeword.csv 的 model 分区 + 选择 wn9 模型,
        srmodels.bin 由 esp-sr 构建系统自动打包),见 firmware/README.md
        「启用唤醒词」。默认关闭(空实现,available() 返回 false;
        esp-sr 依赖被链接器整库裁剪,零体积影响)。

config PX_VOICE_TTS_RING_KB
    int "TTS 下行 PCM 环形缓冲 (KB, PSRAM)"
    range 128 4096
    default 1024
    help
        服务器 TTS 推流快于实时播放时的缓冲。24kHz 单声道下 1MB 约 21.8 秒。

config PX_VOICE_UPLINK_RING_KB
    int "麦克风上行环形缓冲 (KB, PSRAM)"
    range 16 512
    default 64
    help
        采集任务与 WebSocket 发送任务之间的缓冲,吸收网络抖动。
        16kHz 单声道下 64KB 约 2 秒;溢出丢最旧数据。

endmenu
```
